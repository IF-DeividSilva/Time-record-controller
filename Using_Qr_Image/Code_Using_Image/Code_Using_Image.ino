#include <ESP8266WiFi.h>
#include <ESP8266HTTPClient.h>
#include <FS.h> // Para SPIFFS (ou LittleFS se você configurou seu core para isso)

// --- Configurações de Wi-Fi ---
const char* ssid = "NG_Uaifai";      
const char* password = "GD556522"; 

// --- Configurações do Servidor Python Local ---
String localServerIP = "192.168.0.103"; // !!! COLOQUE O IP REAL DO SEU PC ONDE O PYTHON RODA !!!
int localServerPort = 5000;             // Porta que o servidor Flask está usando
String serverPath = "/upload_qr_bytes"; // Endpoint no Python para upload

const unsigned char nugSXt_jpg_data[] PROGMEM = {
0x89, 0x50, 0x4E, 0x47, 0x0D, 0x0A, 0x1A, 0x0A, 0x00, 0x00, 0x00, 0x0D, 0x49, 0x48, 0x44, 0x52, 
0x00, 0x00, 0x01, 0x2C, 0x00, 0x00, 0x01, 0x2C, 0x08, 0x06, 0x00, 0x00, 0x00, 0x79, 0x7D, 0x8E, 
0x75, 0x00, 0x00, 0x00, 0x04, 0x67, 0x41, 0x4D, 0x41, 0x00, 0x00, 0xB1, 0x8F, 0x0B, 0xFC, 0x61, 
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0x3D, 0xCD, 0x00, 0x00, 0x00, 0x00, 0x49, 0x45, 0x4E, 0x44, 0xAE, 0x42, 0x60, 0x82

}; // Não se esqueça do ponto e vírgula final!

// Esta linha CALCULA AUTOMATICAMENTE o tamanho do array.
const unsigned int nugSXt_jpg_len = sizeof(nugSXt_jpg_data);
// ----------------------------------------------------------------------------------

unsigned long previousMillis = 0;
const long interval = 45000; // Intervalo para enviar a imagem (45 segundos)

void setup() {
  Serial.begin(115200);
  delay(1000); 
  Serial.println("\n\nIniciando ESP8266 - Envio de Imagem QR (Array de Bytes Embutido)...");
  Serial.print("Tamanho dos dados da imagem (PROGMEM) a serem enviados: ");
  Serial.println(nugSXt_jpg_len);

  if (nugSXt_jpg_len == 0) {
      Serial.println("ERRO CRÍTICO: O array de bytes da imagem está vazio ou não foi preenchido!");
      Serial.println("Por favor, converta sua imagem nugSXt.jpg para um array de bytes C e cole no código.");
      while(1) delay(1); // Trava se não houver dados da imagem
  }

  Serial.println("Conectando ao Wi-Fi...");
  WiFi.mode(WIFI_STA); // Garante que o ESP está em modo Station
  WiFi.begin(ssid, password);
  
  int retries = 0;
  while (WiFi.status() != WL_CONNECTED && retries < 30) { 
    delay(500); 
    Serial.print("."); 
    retries++;
  }

  if (WiFi.status() == WL_CONNECTED) {
    Serial.println("\nWi-Fi conectado!");
    Serial.print("IP do ESP8266: "); Serial.println(WiFi.localIP());
    Serial.print("Servidor Python esperado em: http://"); Serial.print(localServerIP); 
    Serial.print(":"); Serial.println(localServerPort);
    Serial.print("Caminho no servidor: "); Serial.println(serverPath);
    Serial.println("Enviando a imagem (array de bytes) em breve...");
  } else {
    Serial.println("\nFalha ao conectar ao Wi-Fi. Verifique credenciais/sinal.");
    Serial.println("O ESP tentará reconectar no próximo ciclo do loop se a condição de envio for atingida.");
  }
}

void loop() {
  unsigned long currentMillis = millis();
  if (WiFi.status() == WL_CONNECTED && currentMillis - previousMillis >= interval) {
    previousMillis = currentMillis;
    sendImageDataToServer(nugSXt_jpg_data, nugSXt_jpg_len);
  }
  // Pequeno delay para estabilidade
  delay(100); 
}

void sendImageDataToServer(const unsigned char* imageData, unsigned int imageLength) {
  if (WiFi.status() != WL_CONNECTED) {
    Serial.println("ERRO: Sem conexão Wi-Fi para enviar os dados da imagem.");
    return;
  }
  if (imageLength == 0) {
    Serial.println("ERRO: Dados da imagem (comprimento) estão zerados. Nada a enviar.");
    return;
  }

  Serial.println("------------------------------------------------------");
  Serial.print("Tentando enviar array de bytes da imagem para o servidor Python (Tamanho: "); 
  Serial.print(imageLength); Serial.println(" bytes)");

  HTTPClient http;
  WiFiClient client; 

  String url = "http://" + localServerIP + ":" + String(localServerPort) + serverPath;
  Serial.print("URL da requisição local: "); Serial.println(url);

  if (!http.begin(client, url)) {
    Serial.println("ERRO: http.begin() falhou!");
    return;
  }
  
  // Define o Content-Type correto para a sua imagem (JPEG neste caso)
  http.addHeader("Content-Type", "image/jpeg");
  
  // Envia a requisição POST com o array de bytes como corpo
  // A biblioteca ESP8266HTTPClient pode precisar que os dados de PROGMEM sejam lidos para a RAM primeiro
  // se o envio direto do ponteiro PROGMEM não funcionar para http.POST().
  // Vamos tentar direto. Se falhar, precisaremos copiar para um buffer na RAM.
  int httpCode = http.POST((uint8_t*)imageData, imageLength); 
  
  if (httpCode > 0) {
    Serial.printf("[HTTP Local POST] Código de resposta: %d\n", httpCode);
    String payload = http.getString();
    Serial.println("[HTTP Local POST] Resposta do servidor: " + payload);
  } else {
    // Se httpCode < 0, é um erro da biblioteca HTTPClient antes de enviar ou de conexão
    Serial.printf("[HTTP Local POST] Falha na requisição POST. Erro da lib: %s (Código: %d)\n", http.errorToString(httpCode).c_str(), httpCode);
  }
  
  http.end();   
  Serial.println("------------------------------------------------------");
}